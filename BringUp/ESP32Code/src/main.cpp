#include <Arduino.h>
#include <WiFiManager.h>

#define CLOCK_TIME_US 250

WiFiManager manager;

#define PIN_IN_DATA 8
#define PIN_PAR_LOAD 5
#define PIN_IN_CLOCK 6
#define PIN_RST 4
#define PIN_CLK 3
#define PIN_OUT_CLOCK 2
#define PIN_OUT_DATA 1
#define PIN_LED 0

uint16_t PC;
uint8_t flag_I;
uint8_t MAR;
uint8_t RAM[256];

uint8_t ROM[4096] = {
  0x02, 0x02, 0x02, 0x02, 0x00, 0x02, 0x00, 0x02, 0x53, 0x02, 0x0f, 0x01, 0x02, 0x43, 0x02, 0x0f, 
  0x01, 0x02, 0xa3, 0x02, 0x0f, 0x01, 0x02, 0xb3, 0x02, 0x0f, 0x01, 0x02, 0x23, 0x02, 0x1f, 0x01, 
  0x02, 0x33, 0x02, 0x1f, 0x01, 0x02, 0xd0, 0x02, 0x63, 0x02, 0x0f, 0x01, 0x02, 0x40, 0x02, 0x73, 
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  0xef, 0x02, 0xc3, 0x00, 0x07, 0x02, 0xd3, 0x00, 0x07, 0x02, 0xe3, 0x00, 0x07, 0x04
};

uint8_t cycle;
uint8_t DB0, DB1;
uint8_t uart_state;
uint8_t uart_buff;

void set_inputs(uint8_t ins) {
  for(uint8_t i = 0; i < 8; i++) {
    if((ins & 128) != 0) digitalWrite(PIN_OUT_DATA, HIGH);
    else digitalWrite(PIN_OUT_DATA, LOW);
    digitalWrite(PIN_OUT_CLOCK, HIGH);
    digitalWrite(PIN_OUT_CLOCK, LOW);
    ins <<= 1;
  }
  digitalWrite(PIN_OUT_DATA, LOW);
}

uint8_t get_outputs() {
  uint8_t res = 0;
  for(uint8_t i = 0; i < 8; i++) {
    res <<= 1;
    if(i == 0) {
      digitalWrite(PIN_PAR_LOAD, LOW);
      digitalWrite(PIN_PAR_LOAD, HIGH);
    }else {
      digitalWrite(PIN_IN_CLOCK, HIGH);
      digitalWrite(PIN_IN_CLOCK, LOW);
    }
    res |= digitalRead(PIN_IN_DATA) & 1;
  }
  return res;
}

void cpu_clock() {
  digitalWrite(PIN_CLK, HIGH);
  delayMicroseconds(CLOCK_TIME_US);
  digitalWrite(PIN_CLK, LOW);
  delayMicroseconds(CLOCK_TIME_US);
}

void reset() {
  cycle = 0;
  PC = 0;
  flag_I = 0;
  uart_state = 0;
  memset(RAM, 0, sizeof(RAM));
  digitalWrite(PIN_RST, HIGH);
  for(int i = 0; i < 5; i++) {
    digitalWrite(PIN_CLK, HIGH);
    delayMicroseconds(CLOCK_TIME_US);
    digitalWrite(PIN_CLK, LOW);
    delayMicroseconds(CLOCK_TIME_US);
  }
  digitalWrite(PIN_RST, LOW);
}

void setup() {
  pinMode(PIN_IN_DATA, INPUT);
  pinMode(PIN_LED, OUTPUT);
  digitalWrite(PIN_LED, LOW);
  pinMode(PIN_PAR_LOAD, OUTPUT);
  digitalWrite(PIN_PAR_LOAD, HIGH);
  pinMode(PIN_IN_CLOCK, OUTPUT);
  digitalWrite(PIN_IN_CLOCK, LOW);
  pinMode(PIN_RST, OUTPUT);
  digitalWrite(PIN_RST, HIGH);
  pinMode(PIN_CLK, OUTPUT);
  digitalWrite(PIN_CLK, LOW);
  pinMode(PIN_OUT_CLOCK, OUTPUT);
  digitalWrite(PIN_OUT_CLOCK, LOW);
  pinMode(PIN_OUT_DATA, OUTPUT);
  digitalWrite(PIN_OUT_DATA, LOW);

  sleep(3);
  printf("BEGIN\r\n");

  /*bool success = manager.autoConnect("ESP32_C3_AP");
  if(!success) {
    Serial.printf("Failed to connect to WiFi lmao");
    while(1) sleep(1);
  }
  Serial.printf("Cool, WiFi works.");*/
  digitalWrite(PIN_LED, HIGH);
  reset();
  setvbuf(stdout, NULL, _IONBF, 0);
}

void update() {
  if(cycle == 0) {
    set_inputs((ROM[PC] & 15) << 2);
    delayMicroseconds(CLOCK_TIME_US);
    cpu_clock();
    uint8_t immediate = ((ROM[PC] >> 4) & 15) << 2;
    /*if((ROM[PC] & 15) == 0 && !flag_I) {
      printf("LD addr %02x val %x\n", MAR, RAM[MAR]);
    }*/
    set_inputs(flag_I ? immediate : ((RAM[MAR] & 15) << 2));
    cycle = 1;
  }else if(cycle == 1) {
    cpu_clock();
    DB0 = get_outputs();
    cycle = 2;
  }else if(cycle == 2) {
    cpu_clock();
    cycle = 3;
  }else {
    cpu_clock();
    DB1 = get_outputs();
    PC++;
    cycle = 0;
    flag_I = DB1 >> 7;
    if(((DB1 >> 6) & 1) != 0) {
      PC = DB0 | ((DB1 & 15) << 8);
    }
    if(((DB1 >> 4) & 1) != 0) {
      MAR = DB0;
    }
    if(((DB1 >> 5) & 1) != 0) {
      RAM[MAR] = DB1 & 15;
      if(MAR == 0xEF) {
        if(!uart_state) uart_buff = DB1 & 15;
        else {
          uint8_t c = uart_buff | ((DB1 & 15) << 4);
          if(c == 0x0A) printf("\r\n");
          else if(c != 255) printf("%c", c);
          fflush(stdout);
        }
        uart_state = !uart_state;
      }
    }
  }
}

bool state = false;
void loop() {
  delay(2);
  digitalWrite(PIN_LED, state);
  state = !state;
  update();
  uint8_t outs = get_outputs();
  //printf("PC: %04x, Flags: %x\r\n", PC, outs >> 4);
}